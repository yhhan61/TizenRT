## apps/examples/brcmwifi/Kconfig
```kconfig
#
# For a description of the syntax of this configuration file,
# see kconfig-language at https://www.kernel.org/doc/Documentation/kbuild/kconfig-language.txt
#

config EXAMPLES_BRCMWIFI
	bool "BRCM WIFI Control application"
	default n
	depends on BRCM_WLAN
	---help---
		Enable the Broadcom WiFi Control Application
```

## apps/examples/rp0_demo/Kconfig
```kconfig
config RP0_DEMO
	bool "Raspberry Pi 0 Board Example"
	select I2C
	select I2C_USERIO
	select BCM2835_I2C
	default n
	---help---
		Enable the Raspberry Pi 0 Board Example
```

## external/brcm_wifi/Kconfig
```kconfig
#
# For a description of the syntax of this configuration file,
# see kconfig-language at https://www.kernel.org/doc/Documentation/kbuild/kconfig-language.txt
#
config NETUTILS_WIFI
	bool "BRCM Wi-Fi API"
	default n
	select BRCM_WLAN
	select WPA_SUPPLICANT
	---help---
		Enable support for the BRCM WI-Fi Networking API.
```

## os/arch/arm/src/armv6/Kconfig
```kconfig
#
# For a description of the syntax of this configuration file,
# see kconfig-language at https://www.kernel.org/doc/Documentation/kbuild/kconfig-language.txt
#

comment "ARMv6 Configuration Options"

choice
	prompt "Toolchain Selection"
	default ARMV6_TOOLCHAIN_GNU_EABIW if HOST_WINDOWS
	default ARMV6_TOOLCHAIN_GNU_EABIL if !HOST_WINDOWS

config ARMV6_TOOLCHAIN_BUILDROOT
	bool "Buildroot (Cygwin or Linux)"
	depends on !WINDOWS_NATIVE

config ARMV6_TOOLCHAIN_CODESOURCERYL
	bool "CodeSourcery GNU toolchain under Linux"
	depends on HOST_LINUX
	---help---
		For use with the GNU toolchain built with the NuttX buildroot package.
		This tools may be arm-nuttx-eabi- or, if ARMV6_OABI_TOOLCHAIN is set,
		arm-nuttx-elf-.

config ARMV6_TOOLCHAIN_CODESOURCERYW
	bool "CodeSourcery GNU toolchain under Windows"
	depends on HOST_WINDOWS

config ARMV6_TOOLCHAIN_DEVKITARM
	bool "devkitARM GNU toolchain"
	depends on HOST_WINDOWS

config ARMV6_TOOLCHAIN_GNU_EABIL
	bool "Generic GNU EABI toolchain under Linux (or other POSIX environment)"
	---help---
		This option should work for any modern GNU toolchain (GCC 4.5 or newer)
		configured for arm-none-eabi-.

config ARMV6_TOOLCHAIN_GNU_EABIW
	bool "Generic GNU EABI toolchain under Windows"
	depends on HOST_WINDOWS
	---help---
		This option should work for any modern GNU toolchain (GCC 4.5 or newer)
		configured for arm-none-eabi-.

config ARMV6_TOOLCHAIN_GNU_OABI
	bool "Generic GNU OABI toolchain"
	---help---
		This option should work for any GNU toolchain configured for arm-elf-.

endchoice

config ARMV6_OABI_TOOLCHAIN
	bool "OABI (vs EABI)"
	default n
	depends on ARMV6_TOOLCHAIN_BUILDROOT
	---help---
		Most of the older buildroot toolchains are OABI and are named
		arm-nuttx-elf- vs. arm-nuttx-eabi-

config ARMV6_HAVE_DECODEFIQ
	bool
	default n

config ARMV6_DECODEFIQ
	bool "FIQ Handler"
	default n
	depends on ARMV6_HAVE_DECODEFIQ
	---help---
		Select this option if your platform supports the function
		arm_decodefiq().

config BOOT_RESULT
	bool "Save Boot Result"
	default n
	---help---
		enable boot_result function to store result of last boot
```

## os/arch/arm/src/bcm2835/Kconfig
```kconfig
#
# For a description of the syntax of this configuration file,
# see kconfig-language at https://www.kernel.org/doc/Documentation/kbuild/kconfig-language.txt
#

comment "Broadcom BCM2835 Chip Configuration Options"

choice
	prompt "Broadcom Chip Selection"
	default ARCH_CHIP_RP0W
	depends on ARCH_CHIP_BCM2835

config ARCH_CHIP_RP0W
	bool "RP0W"
	select RP0W
	select ARCH_ARM1176
	select ARCH_USE_MMU
	select ARCH_HAVE_RESET

endchoice

config RP0W
	bool
	default y
	select BCM2835_HAVE_PWR
	select BCM2835_HAVE_PWM0
	select BCM2835_HAVE_PWM1
	select BCM2835_HAVE_SPI
	select BCM2835_HAVE_UART1
	select BCM2835_HAVE_WATCHDOG
	select BCM2835_HAVE_SFLASH

menu "BCM2835 Peripheral Support"

# These "hidden" settings determine peripheral options that are available for
# the selection MCU.

config BCM2835_HAVE_ADC
	bool
	default n

config BCM2835_HAVE_I2C
	bool
	default n

config BCM2835_HAVE_MCT
	bool
	default n

config BCM2835_HAVE_PWM0
	bool
	default n

config BCM2835_HAVE_PWM1
	bool
	default n

config BCM2835_HAVE_PWM2
	bool
	default n

config BCM2835_HAVE_PWM3
	bool
	default n

config BCM2835_HAVE_PWM4
	bool
	default n

config BCM2835_HAVE_PWM5
	bool
	default n

config BCM2835_HAVE_PWR
	bool
	default n

config BCM2835_HAVE_RTC
	bool
	default n

config BCM2835_HAVE_SFLASH
	bool
	default n

config BCM2835_HAVE_SPI
	bool
	default n

config BCM2835_HAVE_SSS
	bool
	default n

config BCM2835_HAVE_UART0
	bool
	default n

config BCM2835_HAVE_UART1
	bool
	default n

config BCM2835_HAVE_WATCHDOG
	bool
	default n

config BCM2835_ADC
	bool "ADC"
	default n
	depends on BCM2835_HAVE_ADC
	select ANALOG
	select ADC
	select SCHED_WORKQUEUE
	select SCHED_LPWORK
	---help---
		BCM2835 has 12-bits ADC with 4 channels. Say Y here, if you want
		to use it.

config BCM2835_SDIO
	bool "SDIO"
	default n
	select ARCH_HAVE_SDIO

config BCM2835_I2C
	bool "BCM2835 I2C"
	default n
	depends on BCM2835_HAVE_I2C

config BCM2835_MCT
	bool
	default n

config BCM2835_TIMER0
	bool "TIMER0"
	default n
	depends on BCM2835_HAVE_MCT
	select BCM2835_MCT

config BCM2835_UART_FLOWCONTROL
	bool
	default n

config BCM2835_UART0
	bool "UART0"
	default n
	depends on BCM2835_HAVE_UART0
	select ARCH_HAVE_UART0
	select ARCH_HAVE_SERIAL_TERMIOS

config BCM2835_UART1
	bool "UART1"
	default n
	depends on BCM2835_HAVE_UART1
	select ARCH_HAVE_UART1
	select ARCH_HAVE_SERIAL_TERMIOS

config BCM2835_PWM
	bool
	default n

config BCM2835_PWM0
	bool "PWM0"
	depends on BCM2835_HAVE_PWM0
	select BCM2835_PWM
	default n

config BCM2835_PWM1
	bool "PWM1"
	depends on BCM2835_HAVE_PWM1
	select BCM2835_PWM
	default n

config BCM2835_SSS
	bool "SSS"
	depends on BCM2835_HAVE_SSS
	default n

config BCM2835_SPI
	bool "SPI"
	depends on BCM2835_HAVE_SPI
	default y

config BCM2835_WATCHDOG
	bool "Watchdog"
	depends on BCM2835_HAVE_WATCHDOG
	default n

menu "Watchdog driver configuration"
	depends on BCM2835_WATCHDOG

config BCM2835_WATCHDOG_RESET
	bool "BCM2835 Watchdog reset enable"
	default n
	depends on BCM2835_WATCHDOG

endmenu


config BCM2835_SFLASH
	bool "SFLASH"
	default y
	depends on BCM2835_HAVE_SFLASH

config BCM2835_PWR
	bool "PMU"
	default n
	depends on BCM2835_HAVE_PWR

menu "PMU Configuration"
	depends on BCM2835_PWR

config BCM2835_PWR_DSTOP
	bool "BCM2835 DSTOP Power Mode"
	default n

config BCM2835_PWR_SLEEP
	bool "BCM2835 SLEEP Power Mode"
	default n

endmenu

config BCM2835_GPIO
	bool "BCM2835 GPIO support"
	default n

config BCM2835_MULTIPLE_GPIO_USE_ONE_IRQ
	bool "BCM2835 all GPIO use one interrupt"
	default y

endmenu
```

## os/arch/arm/src/rp0w/Kconfig
```kconfig
if ARCH_BOARD_RP0W

config RP0W_BOOT_FAILURE_DETECTION
	bool "Clear bootcount when boot completes"
	default y
	---help---
		BL2 sets up a watchdog before it jumps to TinyARA to detect
		boot failures. On a successful boot, the secondary OS should
		turn the watchdog off and clear the bootcount register that
		stores the number of tries to boot. Otherwise, the watchdog
		will bark and BL2 may go into recovery mode.

config RP0W_BOOT_COUNTS_ADDR
	hex "Address of scratch pad register to store the bootcount"
	default 0x80090810
	depends on RP0W_BOOT_FAILURE_DETECTION
	---help---
		The number of tries to boot will be stored in this address.
		On successful boot, it is cleared to zero. The register should
		be kept intact even on watchdog resets.

config RP0W_FLASH_CAPACITY
	int "Size of external flash memory (in bytes)"
	default 8388608
	depends on BCM2835_SFLASH
	---help---
		Sets the capacity of the external flash memory
		on the Raspberry Pi Zero W board.

config RP0W_FLASH_PAGE_SIZE
	int "Page size of external flash memory (in bytes)"
	default 4096
	depends on BCM2835_SFLASH
	---help---
		Sets the page size of the external flash memory on the
		Raspberry Pi Zero W board. It can be the size of erase
		unit flash memory supports.

config RP0W_FLASH_PART
	bool "Enable partition support on FLASH"
	default n
	select MTD_PARTITION
	select MTD_PROGMEM
	depends on BCM2835_SFLASH
	---help---
		Enables creation of partitions on the FLASH

config RP0W_FLASH_MINOR
	int "Minor number for the FLASH device"
	default 0
	depends on RP0W_FLASH_PART
	---help---
		Sets the minor number for /dev node of the external flash
		device.

config RP0W_FLASH_PART_LIST
	string "Flash partition size list (in KBytes)"
	default "16,48,192,32,512,2400,1536,1536,1400,8,512,"
	depends on RP0W_FLASH_PART
	---help---
		Comma separated list of partition sizes in KB.

config RP0W_FLASH_PART_TYPE
	string "Flash partition type list"
	default "none,none,none,none,none,none,none,none,smartfs,config,none,"
	depends on RP0W_FLASH_PART
	---help---
		Comma separated list of partition types that can be one of
		followings: none, smartfs, config

config RP0W_FLASH_PART_NAME
	string "Flash partition name list"
	default "bl1,sssro,bl2,sssfw,wlanfw,os,factory,ota,user,nvram,sssrw,"
	depends on MTD_PARTITION_NAMES
	depends on RP0W_FLASH_PART
	---help---
		Comma separated list of partition names.

config RP0W_AUTOMOUNT
       bool "Automount partitions"
       default n
       depends on RP0W_FLASH_PART
       ---help---
		If enabled, mount userrw and sssrw partitions at boot.

config RP0W_AUTOMOUNT_USERFS
	bool "Automount user r/w partiton"
	default n
	depends on RP0W_AUTOMOUNT
	---help---
		If enabled, user r/w partition will be mounted automatically
		at boot.

config RP0W_AUTOMOUNT_USERFS_DEVNAME
	string "Device name of the partition for user r/w file system"
	default "/dev/smart0p8"
	depends on RP0W_AUTOMOUNT_USERFS
	---help---
		Specifies the device name (/dev/smart0pX) of the partition
		for user r/w file system.

config RP0W_AUTOMOUNT_USERFS_MOUNTPOINT
	string "Mountpoint of the partition for user r/w file system"
	default "/mnt"
	depends on RP0W_AUTOMOUNT_USERFS
	---help---
		Specifies the mount point where user r/w file system
		will be mounted at.

if RAMMTD
config RP0W_RAMMTD_NEBLOCKS
		int "RAM MTD erase block count"
		default 64
		---help---
				Ramfs size will be RAMMTD_ERASESIZE * SIDK_RP0W_RAMMTD_NEBLOCKS.
				You have to consider total ramsize to alloc ramfs size.

config RP0W_RAMMTD_DEV_NUMBER
		int "device number for mtd of smartfs"
		default 3

config RP0W_RAMMTD_DEV_POINT
		string "Device name of the partition for ramfs r/w file system"
		default "/dev/smart3"

config RP0W_RAMMTD_MOUNT_POINT
		string "Mountpoint of the partition for ramfs r/w file system"
		default "/ramfs"
endif
endif
```

## os/drivers/wireless/Kconfig
```kconfig
#
# For a description of the syntax of this configuration file,
# see kconfig-language at https://www.kernel.org/doc/Documentation/kbuild/kconfig-language.txt
#

if DRIVERS_WIRELESS

	if ARCH_CHIP_BCM2835
#source drivers/wireless/brcm/Kconfig
source drivers/wireless/broadcom/Kconfig
	endif

	if SELECT_SCSC_WLAN
source drivers/wireless/scsc/Kconfig
	endif

endif # DRIVERS_WIRELESS
```
